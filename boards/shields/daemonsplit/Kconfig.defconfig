## boards/shields/daemonsplit/Kconfig.defconfig
```kconfig
if SHIELD_DAEMONSPLIT_LEFT

config ZMK_KEYBOARD_NAME
    default "DaemonSplit"

config ZMK_SPLIT_ROLE_CENTRAL
    default y

endif # SHIELD_DAEMONSPLIT_LEFT

if SHIELD_DAEMONSPLIT_LEFT || SHIELD_DAEMONSPLIT_RIGHT

config ZMK_SPLIT
    default y

endif # SHIELD_DAEMONSPLIT_LEFT || SHIELD_DAEMONSPLIT_RIGHT
```

## boards/shields/daemonsplit/Kconfig.shield
```kconfig
config SHIELD_DAEMONSPLIT_LEFT
    def_bool $(shields_list_contains,daemonsplit_left)

config SHIELD_DAEMONSPLIT_RIGHT
    def_bool $(shields_list_contains,daemonsplit_right)
```
